## arch/arm/hotplug/Kconfig
```kconfig
# Kconfig file for hotplugs

config ASMP
	bool "Multi-core automatic hotplug support"
	depends on SMP && HOTPLUG_CPU
	default n
	help
	  Automatically hotplugs the multiple cpu cores on and off
	  based on cpu load and suspend state
```
